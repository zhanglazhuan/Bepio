## debug/t_microphone/sdkconfig.defaults
```kconfig
CONFIG_ESPTOOLPY_FLASHMODE_DIO=y
CONFIG_ESPTOOLPY_FLASHSIZE_16MB=y
CONFIG_ESP_CONSOLE_UART_DEFAULT=y
CONFIG_ESP_CONSOLE_SECONDARY_NONE=y
CONFIG_ESP_MAIN_TASK_STACK_SIZE=6144
# CONFIG_SPIRAM is not set
CONFIG_CODEC_ES8311_SUPPORT=y
# CONFIG_CODEC_ES7210_SUPPORT is not set
# CONFIG_CODEC_ES7243_SUPPORT is not set
# CONFIG_CODEC_ES7243E_SUPPORT is not set
# CONFIG_CODEC_ES8156_SUPPORT is not set
# CONFIG_CODEC_AW88298_SUPPORT is not set
# CONFIG_CODEC_ES8389_SUPPORT is not set
# CONFIG_CODEC_ES8374_SUPPORT is not set
# CONFIG_CODEC_ES8388_SUPPORT is not set
# CONFIG_CODEC_TAS5805M_SUPPORT is not set
```

## debug/t_mn316/sdkconfig.defaults
```kconfig
CONFIG_ESPTOOLPY_FLASHMODE_DIO=y
CONFIG_ESPTOOLPY_FLASHSIZE_16MB=y
CONFIG_ESP_CONSOLE_UART_DEFAULT=y
CONFIG_ESP_CONSOLE_SECONDARY_NONE=y
# CONFIG_SPIRAM is not set
```

## debug/t_multinet/sdkconfig.defaults
```kconfig
CONFIG_ESPTOOLPY_FLASHMODE_DIO=y
CONFIG_ESPTOOLPY_FLASHSIZE_16MB=y
CONFIG_ESP_CONSOLE_USB_SERIAL_JTAG=y
CONFIG_ESP_CONSOLE_SECONDARY_NONE=y
CONFIG_ESP_MAIN_TASK_STACK_SIZE=8192
CONFIG_PARTITION_TABLE_CUSTOM=y
CONFIG_PARTITION_TABLE_CUSTOM_FILENAME="partitions.csv"
CONFIG_SPIRAM=y
CONFIG_SPIRAM_MODE_OCT=y
CONFIG_SPIRAM_SPEED_40M=y
CONFIG_SPIRAM_USE_MALLOC=y
CONFIG_SR_MN_CN_MULTINET7_QUANT=y
CONFIG_SR_MN_EN_NONE=y
CONFIG_MODEL_IN_FLASH=y
CONFIG_CODEC_ES8311_SUPPORT=y
# CONFIG_CODEC_ES7210_SUPPORT is not set
# CONFIG_CODEC_ES7243_SUPPORT is not set
# CONFIG_CODEC_ES7243E_SUPPORT is not set
# CONFIG_CODEC_ES8156_SUPPORT is not set
# CONFIG_CODEC_AW88298_SUPPORT is not set
# CONFIG_CODEC_ES8389_SUPPORT is not set
# CONFIG_CODEC_ES8374_SUPPORT is not set
# CONFIG_CODEC_ES8388_SUPPORT is not set
# CONFIG_CODEC_TAS5805M_SUPPORT is not set
```

## debug/t_tts/sdkconfig.defaults
```kconfig
CONFIG_ESPTOOLPY_FLASHMODE_DIO=y
CONFIG_ESPTOOLPY_FLASHSIZE_16MB=y
CONFIG_ESP_CONSOLE_USB_SERIAL_JTAG=y
CONFIG_ESP_CONSOLE_SECONDARY_NONE=y
CONFIG_ESP_MAIN_TASK_STACK_SIZE=8192
CONFIG_PARTITION_TABLE_CUSTOM=y
CONFIG_PARTITION_TABLE_CUSTOM_FILENAME="partitions.csv"
# CONFIG_SPIRAM is not set
CONFIG_CODEC_ES8311_SUPPORT=y
# CONFIG_CODEC_ES7210_SUPPORT is not set
# CONFIG_CODEC_ES7243_SUPPORT is not set
# CONFIG_CODEC_ES7243E_SUPPORT is not set
# CONFIG_CODEC_ES8156_SUPPORT is not set
# CONFIG_CODEC_AW88298_SUPPORT is not set
# CONFIG_CODEC_ES8389_SUPPORT is not set
# CONFIG_CODEC_ES8374_SUPPORT is not set
# CONFIG_CODEC_ES8388_SUPPORT is not set
# CONFIG_CODEC_TAS5805M_SUPPORT is not set
```

## main/Kconfig.projbuild
```kconfig
menu "Bepio"

config BEPIO_PRODUCTION_BUILD
	bool "Production firmware profile (requires release gate)"
	default n
	help
	  Disables demonstration content. Production builds must also pass the
	  release gate for signed boot, encrypted Flash, rollback and OTA slots.

config BEPIO_UI_OPTIMIZE
	bool "Optimize graphics components for responsiveness (-O2)"
	default y
	help
	  Optimize LVGL, the GUI adapter and LCD components even when the rest
	  of ESP-IDF uses debug optimization. Keeps assertions and symbols.
	  Disable when stepping through graphics code in a debugger.


config BEPIO_CONSOLE
	bool "Optional serial command console (headless diagnostics)"
	default n

config BEPIO_MN316
	bool "Probe MN316 over UART1 at startup"
	default y

config BEPIO_MAX_APPS
	int "Maximum registered applications"
	range 1 25
	default 8

config BEPIO_APP_SETTINGS
	bool "Settings application"
	default y

config BEPIO_SETTINGS_SHELL
	bool "Settings serial shell commands"
	depends on BEPIO_APP_SETTINGS && BEPIO_CONSOLE
	default y

config BEPIO_APP_CONTACTS
	bool "Contacts application"
	default y

config BEPIO_CONTACTS_CAPACITY
	int "Maximum contacts stored in RAM"
	depends on BEPIO_APP_CONTACTS
	range 1 128
	default 32

config BEPIO_CONTACTS_SHELL
	bool "Contacts serial shell commands"
	depends on BEPIO_APP_CONTACTS && BEPIO_CONSOLE
	default y

config BEPIO_APP_MESSAGES
	bool "Messages application and in-memory messaging service"
	default y

config BEPIO_MESSAGES_INBOX_CAPACITY
	int "Maximum inbox messages"
	depends on BEPIO_APP_MESSAGES
	range 1 40
	default 20

config BEPIO_MESSAGES_OUTBOX_CAPACITY
	int "Maximum outbox messages including drafts"
	depends on BEPIO_APP_MESSAGES
	range 1 40
	default 20

config BEPIO_MESSAGES_SHELL
	bool "Messages serial shell commands"
	depends on BEPIO_APP_MESSAGES && BEPIO_CONSOLE
	default y

config BEPIO_MESSAGES_DEMO
	bool "Seed simulated Messages conversations"
	depends on BEPIO_APP_MESSAGES && !BEPIO_PRODUCTION_BUILD
	default y

config BEPIO_APP_CHATS
	bool "Chats application"
	depends on BEPIO_APP_CONTACTS && BEPIO_APP_MESSAGES
	default y

endmenu
```

## sdkconfig.defaults
```kconfig
CONFIG_IDF_TARGET="esp32s3"
CONFIG_ESPTOOLPY_FLASHSIZE_16MB=y
CONFIG_ESPTOOLPY_FLASHMODE_DIO=y
CONFIG_ESP_DEFAULT_CPU_FREQ_MHZ_240=y
# CONFIG_SPIRAM is not set
CONFIG_PARTITION_TABLE_CUSTOM=y
CONFIG_PARTITION_TABLE_CUSTOM_FILENAME="partitions.csv"
CONFIG_ESP_CONSOLE_UART_DEFAULT=y
CONFIG_ESP_CONSOLE_SECONDARY_NONE=y
CONFIG_ESP_MAIN_TASK_STACK_SIZE=6144
CONFIG_LOG_DEFAULT_LEVEL_INFO=y

# CONFIG_BEPIO_CONSOLE is not set
CONFIG_LV_MEM_SIZE_KILOBYTES=64

CONFIG_LV_FONT_MONTSERRAT_20=y
CONFIG_BEPIO_MESSAGES_DEMO=y
CONFIG_CODEC_ES8311_SUPPORT=y
# CONFIG_CODEC_ES7210_SUPPORT is not set
# CONFIG_CODEC_ES7243_SUPPORT is not set
# CONFIG_CODEC_ES7243E_SUPPORT is not set
# CONFIG_CODEC_ES8156_SUPPORT is not set
# CONFIG_CODEC_AW88298_SUPPORT is not set
# CONFIG_CODEC_ES8389_SUPPORT is not set
# CONFIG_CODEC_ES8374_SUPPORT is not set
# CONFIG_CODEC_ES8388_SUPPORT is not set
# CONFIG_CODEC_TAS5805M_SUPPORT is not set
```
